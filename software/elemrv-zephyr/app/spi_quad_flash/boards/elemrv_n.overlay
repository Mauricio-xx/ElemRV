/*
 * SPDX-License-Identifier: Apache-2.0
 *
 * Declares a synthetic flash slave on ElemRV-N SPI0. Compatible string
 * is informational only — the app bypasses the Zephyr flash subsystem
 * and issues raw SPI transactions directly.
 */

&spi0 {
	status = "okay";
	flash@0 {
		compatible = "aesc,generic-spi-sensor";
		reg = <0>;
		spi-max-frequency = <1000000>;
	};
};
