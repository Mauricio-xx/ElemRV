## digital-twin/zephyr/elemrv-zephyr/Kconfig
```kconfig
# SPDX-License-Identifier: Apache-2.0

# ElemRV Zephyr module Kconfig

rsource "drivers/pwm/Kconfig"
rsource "drivers/pio/Kconfig"
rsource "drivers/pinctrl/Kconfig"
rsource "drivers/spi/Kconfig"
```

## digital-twin/zephyr/elemrv-zephyr/boards/aesc/elemrv_h/Kconfig.elemrv_h
```kconfig
# SPDX-License-Identifier: Apache-2.0

config BOARD_ELEMRV_H
	select SOC_ELEMRV_VEXRISCV
```

## digital-twin/zephyr/elemrv-zephyr/drivers/pio/Kconfig
```kconfig
# SPDX-License-Identifier: Apache-2.0

config PIO_WISHBONE
	bool "AESC WishbonePio programmable I/O driver"
	default y
	depends on DT_HAS_AESC_WISHBONE_PIO_ENABLED
	help
	  Enable driver for the AESC WishbonePio programmable I/O controller.
	  Exposes a custom API (elemrv/drivers/pio.h) for command-FIFO-based
	  pin control: HIGH, LOW, WAIT, READ.
```

## digital-twin/zephyr/elemrv-zephyr/dts/bindings/misc/aesc,wishbone-pio.yaml
```yaml
# SPDX-License-Identifier: Apache-2.0

description: AESC WishbonePio programmable I/O controller

compatible: "aesc,wishbone-pio"

include: base.yaml

properties:
  reg:
    required: true
  clock-frequency:
    type: int
    required: true
    description: Input clock frequency in Hz
  num-pins:
    type: int
    required: true
    description: Number of PIO pins (1-6)
```

## digital-twin/zephyr/elemrv-zephyr/dts/bindings/spi/aesc,generic-spi-sensor.yaml
```yaml
# SPDX-License-Identifier: Apache-2.0

description: |
  Generic SPI sensor device (register-addressed).
  Used for digital twin validation with embedded sensor in co-sim wrapper.

compatible: "aesc,generic-spi-sensor"

include: spi-device.yaml
```

## software/elemrv-zephyr/Kconfig
```kconfig
# SPDX-License-Identifier: Apache-2.0

# ElemRV Zephyr module Kconfig

rsource "drivers/pwm/Kconfig"
```

## software/elemrv-zephyr/boards/aesc/elemrv_h/Kconfig.defconfig
```kconfig
# SPDX-License-Identifier: Apache-2.0

if BOARD_ELEMRV_H

config BOARD
	default "elemrv_h"

endif # BOARD_ELEMRV_H
```

## software/elemrv-zephyr/boards/aesc/elemrv_h/board.yml
```yaml
board:
  name: elemrv_h
  full_name: ElemRV Hydrogen RISC-V SoC
  vendor: aesc
  socs:
    - name: elemrv_vexriscv
```

## software/elemrv-zephyr/drivers/pinctrl/Kconfig
```kconfig
# SPDX-License-Identifier: Apache-2.0

config PINMUX_WISHBONE
	bool "AESC WishbonePinmux pin multiplexer driver"
	default y
	depends on DT_HAS_AESC_WISHBONE_PINMUX_ENABLED
	help
	  Enable driver for the AESC WishbonePinmux pin multiplexer.
	  Routes internal peripheral signals (GPIO, UART, PWM, I2C, PIO)
	  to physical pins. Custom API via elemrv/drivers/pinmux.h.
```

## software/elemrv-zephyr/drivers/pwm/Kconfig
```kconfig
# SPDX-License-Identifier: Apache-2.0

config PWM_WISHBONE
	bool "AESC WishbonePwm driver"
	default y
	depends on DT_HAS_AESC_WISHBONE_PWM_ENABLED
	select PWM
	help
	  Enable driver for the AESC WishbonePwm controller.
	  Supports 2 channels with 20-bit period/duty registers.
```

## software/elemrv-zephyr/drivers/spi/Kconfig
```kconfig
# SPDX-License-Identifier: Apache-2.0

config SPI_NAFARR
	bool "Nafarr Wishbone SPI controller driver"
	default y
	depends on DT_HAS_AESC_NAFARR_SPI_ENABLED
	select SPI_HAS_CS_CONTROL
	help
	  Enable driver for the nafarr WishboneSpiController.
	  Uses command-FIFO interface with IpIdentification headers.
```

## software/elemrv-zephyr/dts/bindings/pinctrl/aesc,wishbone-pinmux.yaml
```yaml
# SPDX-License-Identifier: Apache-2.0

description: AESC WishbonePinmux pin multiplexer controller

compatible: "aesc,wishbone-pinmux"

include: base.yaml

properties:
  reg:
    required: true
  num-pins:
    type: int
    required: true
    description: Number of physical pins (1-32)
  num-options:
    type: int
    required: true
    description: Number of mux options per pin (2-8)
```

## software/elemrv-zephyr/dts/bindings/pwm/aesc,wishbone-pwm.yaml
```yaml
# SPDX-License-Identifier: Apache-2.0

description: AESC WishbonePwm controller (2 channels, 20-bit period/duty)

compatible: "aesc,wishbone-pwm"

include: [pwm-controller.yaml, base.yaml]

properties:
  reg:
    required: true

  "#pwm-cells":
    const: 2

  clock-frequency:
    type: int
    required: true
    description: |
      Base input clock frequency in Hz. PWM period and duty cycle
      registers count in cycles of this clock.

pwm-cells:
  - channel
  - flags
```

## software/elemrv-zephyr/dts/bindings/spi/aesc,nafarr-spi.yaml
```yaml
# SPDX-License-Identifier: Apache-2.0

description: |
  AESC nafarr WishboneSpiController — command-FIFO SPI master.
  Uses IpIdentification header and command/response FIFO at offset 0x050.

compatible: "aesc,nafarr-spi"

include: [spi-controller.yaml, base.yaml]

properties:
  reg:
    required: true

  clock-frequency:
    type: int
    required: true
    description: |
      System clock frequency in Hz. SPI clock = sys_clk / (2 * divider).
```

## software/elemrv-zephyr/soc/aesc/elemrv_vexriscv/Kconfig.soc
```kconfig
# SPDX-License-Identifier: Apache-2.0

config SOC_ELEMRV_VEXRISCV
	bool
	help
	  ElemRV Hydrogen VexRiscv RV32IC SoC with LiteX-compatible peripherals.

config SOC
	default "elemrv_vexriscv" if SOC_ELEMRV_VEXRISCV
```
